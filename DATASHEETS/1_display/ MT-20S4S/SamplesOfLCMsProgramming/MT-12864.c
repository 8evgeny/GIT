//Пример программы для вывода картинки на индикатор MT-12864

void main(void) {
byte	p;//Номер текущей страницы индикатора
byte	c;//Позиция по горизонтали выводимого байта

	LCDinit();
	for(p=0; p<8; p++) {//Цикл по всем 8-ми страницам индикатора
		WriteCodeL(p|0xB8);//Установка текущей страницы для левого кристалла индикатора
		WriteCodeL(0x40);//Установка текущего адреса для записи данных в 0 для левого кристалла индикатора
		for(c=0; c<64; c++) {//Цикл вывода данных в левую половину индикатора
			WriteDataL(Logo128[p][c]);//Вывод очередного байта в индикатор
		}
		WriteCodeR(p|0xB8);//Установка текущей страницы для правого кристалла индикатора
		WriteCodeR(0x40);//Установка текущего адреса для записи данных в 0 для правого кристалла индикатора
		for(c=64; c<128; c++) {//Цикл вывода данных в правую половину индикатора
			WriteDataR(Logo128[p][c]);//Вывод очередного байта в индикатор
		}
	}
}

//Процедура программной инициализации индикатора
void LCDinit(void) {
	LCD.E=0;//Начальное значение сигнала индикатору
	LCD.RES=0;//Выдать сигнал RES=0 индикатору
	Delay(>1us);//Задержка на время больше 1 мкс
	LCD.RES=1;//Снять сигнал RES
	Delay(>10us);//Задержка на время больше 10 мкс
	WriteCodeL(0xC0);//Верхнюю строку на 0
	WriteCodeR(0xC0);//Верхнюю строку на 0
	WriteCodeL(0x3F);//Display on
	WriteCodeR(0x3F);//Display on
}

void Pset(byte x, byte y, bit c) {//Записать одну точку в индикатор (координата 0,0 в левом верхнем углу индикатора)
byte c8;//Временное хранение считаного из индикатора байта
byte m8;//Маска нужного бита в байте
	if ((x>127)||(y>63)) return;//Выход за пределы индикатора
	if (x<64) {//Выводить в левую половину индикатора
		WriteCodeL(0xB8|(y>>3));//Установить нужную страницу индикатора
		WriteCodeL(0x40|x);//Установить адрес нужного байта
		c8=ReadDataL();//Фиктивное чтение
		c8=ReadDataL();//Чтение нужного байта из индикатора
		m8=1<<(y&0x07);//Вычислить маску нужного бита в байте
		if (c==1)	//Зажигать точку?
			c8|=m8//Установить нужный бит в байте
		else		//Или гасить точку?
			c8&=~m8;//Сбросить нужный бит в байте
		WriteCodeL(0x40|x);//Снова установить адрес нужного байта
		WriteDataL(c8);//Записать изменённый байт обратно в индикатор
	} else {//Выводить в правую половину индикатора
		WriteCodeR(0xB8|(y>>3));//Установить нужную страницу индикатора
		WriteCodeR(0x40|(x-64));//Установить адрес нужного байта
		c8=ReadDataR();//Фиктивное чтение
		c8=ReadDataR();//Чтение нужного байта из индикатора
		m8=1<<(y&0x07);//Вычислить маску нужного бита в байте
		if (c==1)	//Зажигать точку?
			c8|=m8//Установить нужный бит в байте
		else		//Или гасить точку?
			c8&=~m8;//Сбросить нужный бит в байте
		WriteCodeR(0x40|(x-64));//Снова установить адрес нужного байта
		WriteDataR(c8);//Записать изменённый байт обратно в индикатор
	}
}

void WriteCodeL(byte b) { WriteByte(b,0,1,0); }//Команду в левый кристалл индикатора
void WriteCodeR(byte b) { WriteByte(b,0,0,1); }//Команду в правый кристалл индикатора

void WriteDataL(byte b) { WriteByte(b,1,1,0); }//Данные в левую половину индикатора
void WriteDataR(byte b) { WriteByte(b,1,0,1); }//Данные в правую половину индикатора

byte ReadDataL(void) { return ReadByte(1,1,0); }//Прочитать байт данных из левой половины индикатора
byte ReadDataR(void) { return ReadByte(1,0,1); }//Прочитать байт данных из правой половины индикатора

//Процедура выдачи байта в индикатор
void WriteByte(byte b, bit cd, bit l, bit r) {
	if ((l==1)&&(r==1)) return;	//Читать (для опроса готовности) одновременно из обоих кристаллов недопустимо!
	WaitReady(l,r);		//Ждать готовности индикатора
//При необходимости настроить здесь шину данных на вывод
	LCD.RW=0; LCD.A0=cd;	//Выдача байта в индикатор как данных или команды
	LCD.E1=l; LCD.E2=r;	//Выбрать нужные нужные кристаллы в индикаторе
	LCD.D=b;		//Выдать байт на шину данных индикатора
	Delay(>140ns);		//Это время предустановки адреса (tAW)
	LCD.E=1;		//Сформировать строб записи в индикатор E=1
	Delay(>450ns);		//Длительность сигнала E=1 (время предустановки данных попало сюда (tDS))
	LCD.E=0;		//Сбросить сигнал E
	Delay(>(1000ns-140ns-450ns));	//Минимально допустимый интервал между сигналами E=1
}

byte ReadByte(bit cd, bit l, bit r) {
byte b;
	if ((l==1)&&(r==1)) return 0;	//Читать одновременно из обоих кристаллов недопустимо!
	WaitReady(l,r);		//Ждать готовности индикатора
	LCD.RW=1; LCD.A0=cd;	//Будем читать байт как команду или данные
	LCD.E1=l; LCD.E2=r;	//Выбрать нужные нужные кристаллы в индикаторе
	Delay(>140ns);		//Это время предустановки адреса (tAW)
	LCD.E=1; 		//Выдать строб в индикатор
	Delay(>450ns);		//Минимально допустимая длительность сигнала E=1 (время доступа (tDDR) попало сюда)
	b=LCD.D;		//Прочитать данные с шины индикатора (они на ней уже минимум 130нс)
	LCD.E=0;		//Сбросить сигнал E
	Delay(>(1000ns-140ns-450ns));	//Минимально допустимый интервал между сигналами E=1
	return b;		//Вернуть прочитанный байт
}

void WaitReady(bit l, bit r) {//Ждать готовности индикатора, опрашивая байт статуса
//При необходимости настроить здесь шину данных на ввод
	LCD.RW=1; LCD.A0=0;	//Чтение флага занятости
	LCD.E1=l; LCD.E2=r;	//Выбрать нужные нужные кристаллы в индикаторе
	Delay(>140ns);		//Это время предустановки адреса (tAW)
	LCD.E=1; Delay(>450ns);	//Минимальная длительность сигнала E=1 (информация на шину данных индикатором будет выдана раньше, не более чем через 320нс)
	while(LCD.D.7==1);	//Ждать сброса флага занятости
	LCD.E=0;		//Сбросить сигнал E
	Delay(>(1000ns-140ns-450ns));	//Минимально допустимый интервал между сигналами E=1
}

//Данные изображения, побитые по строкам и байты будут на индикаторе вертикально.
//Это просто последовательность байт для записи в индикатор начиная с верхней страницы.
//Полностью соответствуют картинке распределения ОЗУ в документации на модуль.
const byte Logo128[8][128]=//128x64 pixel, каждые 8 вертикальных точек собраны в байт
{
	{	0xFF,0x01,0x01,0x01,0x01,0x01,0x01,0x01,0x01,0x01,0x01,0x01,0x01,0x01,0x01,0x01,
		0x01,0x01,0x01,0x01,0x01,0x01,0x01,0x01,0x01,0x01,0x01,0x01,0x01,0x01,0x01,0x01,
		0x01,0x01,0x01,0x01,0x01,0x01,0x01,0x01,0x01,0x01,0x01,0x01,0x01,0x01,0x01,0x01,
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		0x01,0x01,0x01,0x01,0x01,0x01,0x01,0x01,0x01,0x01,0x01,0x01,0x01,0x01,0x01,0xFF
	},
	{	0xFF,0x00,0x00,0x00,0x00,0x00,0x00,0x00,0x80,0xC0,0xE0,0xC0,0xE0,0xF0,0xF0,0xF0,
		0xF0,0xF0,0xF0,0xF0,0xF0,0xF0,0xF0,0xF0,0xF0,0xF0,0xE0,0xE0,0xE0,0xC0,0x80,0x00,
		0x00,0x00,0x00,0x80,0x00,0x00,0x00,0x80,0x00,0x80,0x00,0x80,0x00,0x80,0x00,0x80,
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		0x80,0x00,0x80,0x00,0x80,0x00,0x80,0x00,0x80,0x00,0x80,0x00,0x80,0x00,0x80,0x3F
	},
	{	0x1F,0xC0,0xE0,0xE0,0xFC,0xFE,0xF3,0xE3,0xE3,0xE3,0xE3,0xAF,0x6F,0xFF,0xFF,0xFF,
		0xBF,0xBF,0xFF,0xFF,0x7F,0x7F,0xFF,0xFF,0xFF,0xFF,0xFF,0xFF,0xFF,0xFF,0xFF,0xFF,
		0xFF,0xF6,0xF4,0x1F,0x21,0xE2,0x61,0x6F,0x60,0x6F,0x64,0x6F,0x60,0x6F,0x65,0x68,
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		0x6D,0x60,0x6F,0x62,0x6F,0x60,0x6F,0x64,0x6F,0x60,0x6F,0x65,0x68,0x64,0x6A,0x6F
	},
	{	0xFE,0x3F,0x3F,0x3F,0xBF,0xFF,0xFF,0xFF,0xFF,0xFF,0xFF,0xFF,0xFE,0xF9,0x77,0x37,
		0x03,0x03,0x01,0x00,0x00,0x00,0x00,0x01,0x07,0x0F,0x13,0x01,0x00,0x00,0x01,0x07,
		0xD7,0x0E,0x08,0xC0,0x00,0x10,0x0F,0xF8,0x00,0x00,0x80,0xE0,0xF8,0xFE,0xFF,0xFF,
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		0x0F,0x0F,0xFF,0xFF,0xFF,0xFF,0xFF,0x0F,0x0F,0x0F,0x0F,0x0F,0x0F,0x0F,0x06,0xF0
	},
	{	0x3F,0xE0,0x00,0x00,0x01,0x3F,0xFF,0xFF,0xFF,0xFF,0xFF,0x3F,0x3F,0x00,0x00,0xE0,
		0x00,0x00,0x00,0x00,0x00,0x00,0x00,0x00,0x00,0x00,0x00,0x00,0x00,0x00,0x00,0x00,
		0x00,0x01,0x01,0xC1,0xE0,0xE0,0xF9,0xFF,0xFC,0xFF,0xFF,0x7F,0x1F,0xFF,0xFF,0xFF,
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		0x00,0x00,0xFF,0xFF,0xFF,0xFF,0xFF,0x00,0x00,0x00,0x00,0x00,0x00,0x00,0x00,0xFF
	},
	{	0xFC,0x01,0x03,0x04,0x18,0x20,0x40,0x81,0x87,0x07,0x07,0x00,0x00,0x00,0x00,0x00,
		0x00,0x00,0x00,0x00,0x00,0x00,0x00,0x00,0x00,0x00,0x00,0x00,0x00,0x00,0x00,0x80,
		0x80,0xE4,0xE7,0xFB,0xFF,0xFF,0x7F,0x3F,0x0F,0x03,0x01,0x00,0x00,0xFF,0xFF,0xFF,
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		0x00,0x00,0xFF,0xFF,0xFF,0xFF,0xFF,0x00,0x00,0x00,0x00,0x00,0x00,0x00,0x00,0xFF
	},
	{	0xFF,0x00,0x00,0x00,0x00,0x00,0x00,0x00,0x00,0x01,0x02,0x02,0x04,0x04,0x04,0x0C,
		0x0C,0x0C,0x0C,0x0C,0x0C,0x0C,0x0C,0x0C,0x0C,0x04,0x04,0x04,0x02,0x03,0x01,0x00,
		0x00,0x03,0x07,0x07,0x03,0x01,0x00,0x00,0x00,0x00,0x00,0x00,0x00,0x03,0x07,0x07,
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		0x00,0x00,0x03,0x07,0x07,0x07,0x03,0x00,0x00,0x00,0x00,0x00,0x00,0x00,0x00,0xFF
	},
	{	0xFF,0x80,0x80,0x80,0x80,0x80,0x80,0x80,0x80,0x80,0x80,0x80,0x80,0x80,0x80,0x80,
		0x80,0x80,0x80,0x80,0x80,0x80,0x80,0x80,0x80,0x80,0x80,0x80,0x80,0x80,0x80,0x80,
		0x80,0x80,0x80,0x80,0x80,0x80,0x80,0x80,0x80,0x80,0x80,0x80,0x80,0x80,0x80,0x80,
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		0x80,0x80,0x80,0x80,0x80,0x80,0x80,0x80,0x80,0x80,0x80,0x80,0x80,0x80,0x80,0xFF
	}
};
